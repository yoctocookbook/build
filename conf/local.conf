## conf/local.conf
```bitbake
MACHINE ??= 'wandboard-quad'
DISTRO ?= 'poky'
PACKAGE_CLASSES ?= "package_rpm"
EXTRA_IMAGE_FEATURES = "debug-tweaks"
USER_CLASSES ?= "buildstats image-mklibs image-prelink"
PATCHRESOLVE = "noop"
BB_DISKMON_DIRS = "\
    STOPTASKS,${TMPDIR},1G,100K \
    STOPTASKS,${DL_DIR},1G,100K \
    STOPTASKS,${SSTATE_DIR},1G,100K \
    ABORT,${TMPDIR},100M,1K \
    ABORT,${DL_DIR},100M,1K \
    ABORT,${SSTATE_DIR},100M,1K" 
PACKAGECONFIG_append_pn-qemu-native = " sdl"
PACKAGECONFIG_append_pn-nativesdk-qemu = " sdl"
ASSUME_PROVIDED += "libsdl-native"
CONF_VERSION = "1"

BB_NUMBER_THREADS = '8'
PARALLEL_MAKE = '-j 8'

DL_DIR ?= "${BSPDIR}/downloads/"
ACCEPT_FSL_EULA = "1"

# Ch 1, Building your first image
INHERIT += "rm_work"
RM_OLD_IMAGE = "1"

PRSERV_HOST = "localhost:0"

# Ch 4, Preparing and using an SDK
#IMAGE_INSTALL_append = " glibc-staticdev"
SDKIMAGE_FEATURES_append = " staticdev-pkgs"

# Ch 4, Using the Eclipse IDE
EXTRA_IMAGE_FEATURES += "eclipse-debug"

# Ch 4, Developing QT applications
# EXTRA_IMAGE_FEATURES += "qt4-pkgs"
# IMAGE_INSTALL_append = " icu"

# Ch 4, Describing workflows for applicaion development
# External source development
INHERIT += "externalsrc"
EXTERNALSRC_pn-helloworld = "/opt/yocto/helloworld"
EXTERNALSRC_BUILD_pn-helloworld = "/opt/yocto/helloworld"

# Ch 4, Working with the Linux framebuffer
#IMAGE_INSTALL_append = " qt-helloworld"

# Ch 4, Working with the Linux framebuffer
#DISTRO_FEATURES_remove = "x11 directfb wayland"

# Ch 4, Using the X windows system
#IMAGE_INSTALL_append = " gtk-helloworld"
#EXTRA_IMAGE_FEATURES += "qt4-pkgs"
#IMAGE_INSTALL_append = " qtx11-helloworld"

# Ch 4, Using Wayland
DISTRO_FEATURES_remove = "x11"
IMAGE_INSTALL_append = " gtk3-helloworld"
```
